/dts-v1/;
/plugin/;
/ {
/*
	fragment@0 {
		target = <&spi1>;
		__overlay__ {
			pinctrl-names = "default";
			pinctrl-0 = <&spi1m1_pins &spi1m1_cs0>;
			status = "okay";
		};
	};
*/
    fragment@0 {
        target = <&spi1>;
        __overlay__ {
            status = "okay";
            #address-cells = <1>;
            #size-cells = <0>;
            pinctrl-names = "default";
            pinctrl-0 = <&spi1m1_custom>;
            max-freq = <48000000>;

            wk2124: spi-wk2124@0 {
                compatible = "wkmic,wk2124_spi";
                reg = <0>;
                spi-max-frequency = <10000000>;
                status = "okay";

                irq-gpio = <&gpio0 6 0>;
            };
        };
    };

    fragment@1 {
        target = <&pinctrl>;
        __overlay__ {
            spi1m1_custom: spi1m1-custom {
                rockchip,pins =
                    // clk: GPIO3_C3, function 3 (SPI1_CLK_M1)
                    <3 19 3 &pcfg_pull_up>,
                    // mosi: GPIO3_C1, function 3 (SPI1_MOSI_M1)
                    <3 17 3 &pcfg_pull_up>,
                    // miso: GPIO3_C2, function 3 (SPI1_MISO_M1)
                    <3 18 3 &pcfg_pull_up>,
                    // cs0: GPIO3_A1, function 3 (SPI1_CS0_M1)
                    <3 1 3 &pcfg_pull_up>;
            };
        };
    };
};
